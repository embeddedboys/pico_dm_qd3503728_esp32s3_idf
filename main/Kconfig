## main/Kconfig
```kconfig
menu "PUD device"

    config PUD_LVGL_DEMO
        bool "Run the original LVGL demo instead of the PUD device firmware"
        default n
        help
            Keeps the vendor demo (LovyanGFX + LVGL 9 demo selector) buildable
            as a known-good reference for the display/touch hardware.  Default
            is the PUD device firmware.

endmenu
```

## tests/s3_smoke/sdkconfig.defaults
```kconfig
CONFIG_IDF_TARGET="esp32s3"
CONFIG_ESPTOOLPY_FLASHSIZE_16MB=y
CONFIG_PARTITION_TABLE_SINGLE_APP_LARGE=y
CONFIG_ESP_DEFAULT_CPU_FREQ_MHZ_240=y
CONFIG_ESP_CONSOLE_UART_CUSTOM=y
CONFIG_ESP_CONSOLE_UART_CUSTOM_NUM_0=y
CONFIG_ESP_CONSOLE_UART_TX_GPIO=42
CONFIG_ESP_CONSOLE_UART_RX_GPIO=41
CONFIG_ESP_CONSOLE_UART_BAUDRATE=115200
CONFIG_SPIRAM=y
CONFIG_SPIRAM_MODE_OCT=y
CONFIG_SPIRAM_SPEED_80M=y
CONFIG_SPIRAM_USE_MALLOC=y
CONFIG_SPIRAM_MEMTEST=y
CONFIG_FREERTOS_UNICORE=n
CONFIG_LOG_DEFAULT_LEVEL_INFO=y
```
